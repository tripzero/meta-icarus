## conf/layer.conf
```bitbake
BBPATH .= ":${LAYERDIR}"

BBFILES += "${LAYERDIR}/recipes-*/*/*.bb ${LAYERDIR}/recipes-*/*/*.bbappend"

BBFILE_COLLECTIONS += "icarus"
BBFILE_PATTERN_icarus := "^${LAYERDIR}/"
BBFILE_PRIORITY_icarus = "9"
```
